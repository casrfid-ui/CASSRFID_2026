## project/firmware/box/main/Kconfig.projbuild
```kconfig
menu "Forest box"
    config BOX_ID
        int "Box id (1..7)"
        default 1
        range 1 7
    config BOX_OTHER_ID
        int "Id of the other box (0 = none)"
        default 2
        range 0 7
    config BOX_UTC_OFFSET_MIN
        int "Site UTC offset (minutes)"
        default 60
    config BOX_STATIC_LAT_E7
        int "Surveyed latitude x 1e7 (0 = use the GPS only)"
        default 0
    config BOX_STATIC_LON_E7
        int "Surveyed longitude x 1e7"
        default 0
    config BOX_LORA_FREQ_HZ
        int "LoRa frequency (Hz). Authorised use in the target country: to check (spec open decision 3)"
        default 433175000
    config BOX_LORA_TX_DBM
        int "LoRa TX power (dBm)"
        default 14
        range 2 17
    config BOX_WIFI_SSID
        string "Gateway Wi-Fi SSID (camera upload only)"
        default "gateway"
    config BOX_WIFI_PASS
        string "Gateway Wi-Fi password"
        default "changeme"
    config BOX_GATEWAY_URL
        string "Gateway vision service URL"
        default "http://192.168.4.1:8080/v1/frame"
    config BOX_SIM_SEED
        int "Seed of the simulated wind and rain"
        default 1
endmenu
```

## project/firmware/box/sdkconfig.defaults
```kconfig
CONFIG_IDF_TARGET="esp32"
CONFIG_ESPTOOLPY_FLASHSIZE_4MB=y
CONFIG_SPIRAM=y
CONFIG_SPIRAM_USE_CAPS_ALLOC=y
CONFIG_ESP_DEFAULT_CPU_FREQ_MHZ_80=y
CONFIG_PM_ENABLE=n
CONFIG_ESP_TASK_WDT_TIMEOUT_S=60
CONFIG_BOOTLOADER_LOG_LEVEL_WARN=y
CONFIG_LOG_DEFAULT_LEVEL_INFO=y
CONFIG_NEWLIB_TIME_SYSCALL_USE_RTC_HRT=y
CONFIG_ESP_CONSOLE_NONE=y
```

## project/firmware/gateway_bridge/main/Kconfig.projbuild
```kconfig
menu "Forest gateway bridge"
    config GW_ID
        int "Gateway id (8..11)"
        default 8
        range 8 11
    config GW_LORA_FREQ_HZ
        int "LoRa frequency (Hz), same as the boxes"
        default 433175000
    config GW_LORA_TX_DBM
        int "LoRa TX power (dBm)"
        default 14
    config GW_SPREADING_FACTOR
        int "Spreading factor (7..12), same as the boxes"
        default 9
    config GW_EMERGENCY_NUMBERS
        string "Emergency SMS numbers, international form, separated by ';' (the SBC can replace them)"
        default ""
    config GW_SIM_PIN
        string "SIM PIN (empty = none)"
        default ""
endmenu
```

## project/firmware/gateway_bridge/sdkconfig.defaults
```kconfig
CONFIG_IDF_TARGET="esp32"
CONFIG_ESPTOOLPY_FLASHSIZE_4MB=y
CONFIG_ESP_TASK_WDT_TIMEOUT_S=30
CONFIG_ESP_CONSOLE_UART_DEFAULT=y
CONFIG_NEWLIB_TIME_SYSCALL_USE_RTC_HRT=y
```
